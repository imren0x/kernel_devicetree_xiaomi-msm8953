&i2c_3 {
	status = "ok";
	clock-frequency = <400000>;
	focaltech@38{
		compatible = "focaltech,fts_ts-mi8953";
		focaltech,ic-type = <>; // Unknown
		reg = <0x38>;
		interrupt-parent = <&tlmm>;
		interrupts = <65 0x2>;
		vdd-supply = <&pm8953_l10>;
		vcc_i2c-supply = <&pm8953_l6>;
		/* pins used by touchscreen */
                        pinctrl-names = "pmx_ts_active","pmx_ts_suspend",
                                                        "pmx_ts_release";
                        pinctrl-0 = <&ts_int_active &ts_reset_active>;
                        pinctrl-1 = <&ts_int_suspend &ts_reset_suspend>;
                        pinctrl-2 = <&ts_release>;
		focaltech,reset-gpio = <&tlmm 64 0x00>;
		focaltech,irq-gpio = <&tlmm 65 0x02>;
		focaltech,display-coords = <0 0 720 1440>;
		focaltech,max-touch-number = <10>;
		focaltech,ignore-id-check;
		focaltech,charger-detect;
		focaltech,esd-check;
	};

	goodix@5d{
		compatible = "goodix,gt9xx";
		status = "okay";
		reg = <0x5d>;
		interrupt-parent = <&tlmm>;
		interrupts = <65 0x2008>;
		vdd_ana-supply = <&pm8953_l10>;
		vcc_i2c-supply = <&pm8953_l6>;
		pinctrl-names = "gdix_ts_int_default", "gdix_ts_int_output_low",
				"gdix_ts_int_output_high", "gdix_ts_int_input",
				"gdix_ts_rst_default", "gdix_ts_rst_output_low",
				"gdix_ts_rst_output_high", "gdix_ts_rst_input";
		pinctrl-0 = <&ts_int_default>;
		pinctrl-1 = <&ts_int_output_low>;
		pinctrl-2 = <&ts_int_output_high>;
		pinctrl-3 = <&ts_int_input>;
		pinctrl-4 = <&ts_rst_default>;
		pinctrl-5 = <&ts_rst_output_low>;
		pinctrl-6 = <&ts_rst_output_high>;
		pinctrl-7 = <&ts_rst_input>;
		reset-gpios = <&tlmm 64 0x00>;
		irq-gpios = <&tlmm 65 0x2008>;
		irq-flags = <1>;
		touchscreen-max-id = <10>;
		touchscreen-size-x = <720>;
		touchscreen-size-y = <1440>;
		touchscreen-max-w = <1024>;
		touchscreen-max-p = <1024>;
		goodix,type-a-report = <0>;
		goodix,driver-send-cfg = <1>;
		goodix,wakeup-with-reset = <0>;
		goodix,resume-in-workqueue = <1>;
		goodix,int-sync = <1>;
		goodix,swap-x2y = <0>;
		goodix,esd-protect = <1>;
		goodix,pen-suppress-finger = <0>;
		goodix,auto-update = <1>;
		goodix,auto-update-cfg = <0>;
		goodix,power-off-sleep = <0>;
		goodix,slide-wakeup = <1>;
		goodix,cfg-group0 = [
                     52 D0 02 A0 05 0A 3C 10 11 5A 37
                     0F 5A 46 08 62 00 00 00 00 12 13
                     02 30 00 00 2E 87 27 EE 32 34 64
                     09 0F 0A 00 C3 33 91 00 00 00 00
                     00 A3 40 0A 0F DC 22 19 46 83 E0
                     A4 19 28 23 04 CF 1B 00 AF 21 00
                     8A 2D 00 73 3B 00 6A 43 00 68 00
                     00 00 00 00 00 00 00 00 00 4B 02
                     00 00 00 00 00 00 00 02 00 00 28
                     28 00 00 00 00 00 07 5A 00 00 00
                     00 32 0D 0C 0B 0A 09 08 07 06 05
                     04 03 02 01 00 1B 1A 19 18 17 16
                     15 14 13 12 11 10 0F 0E FF FF 2A
                     29 24 22 20 1F 1E 0A 08 06 05 04
                     02 00 FF FF FF 00 00 00 00 00 00
                     00 00 00 37 41 4B 0A 1E 37 F6 0A
                     00 99 99 2D 1F 48 84 D8 00 00 00
                     00 00 00 28 50 00 00 00 0A 5E 14
                     80 00 01 0F 78 46 65 1E 86 40 28
                     33 62 0F 50 19 00 00 85 44 1E 3A
                     0F 0F 28 64 0F 25 D3 01
                ];
	};
};
