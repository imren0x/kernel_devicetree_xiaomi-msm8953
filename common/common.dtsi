#include "android.dtsi"
#include "ramoops.dtsi"
#include "pinctrl.dtsi"
#include "spi.dtsi"
#include "soc.dtsi"
#include "audio.dtsi"
#include "regulator.dtsi"
#include "display.dtsi"
#include "leds.dtsi"
#include "haptic.dtsi"
#include "spi.dtsi"
#include "soc.dtsi"